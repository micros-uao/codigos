#include <FreeRTOS_ARM.h>


float output=0;
double coef[61] = {0.00068524,0.00085037,0.0010195,0.0011769,0.0012822,0.0012724,0.0010702,0.00059694,-0.0002105,-0.0013814,-0.0028938,-0.0046615,-0.0065274,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0.00085037,0.00068524};
double x[61]={0.0000,0.0000,0.0000,0.0000,0.0000,0.0000,0.0000,0.0000,0.0000,0.0000,0.0000,0.0000,0.0000,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0.0000,0.0000};
double sensorValue=0;

void setup() {
Serial.begin(115200);
analogWriteResolution(12); 
analogReadResolution(12);
pinMode(DAC0,OUTPUT);
pinMode(13,OUTPUT);

xTaskCreate(salida, NULL,configMINIMAL_STACK_SIZE , NULL, 1, NULL);
vTaskStartScheduler(); 

}


//Tarea de filtrar la señal
static void salida(void*arg){

portTickType xLastWakeTime;
xLastWakeTime = xTaskGetTickCount();

  while (1) {
    
    //digitalWrite(13,HIGH);
    
    sensorValue=analogRead(A0);
    
    x[0]=sensorValue;
    
    for(int i=1;i<62;i++){x[62-i]=x[61-i];}
    
    for (int k = 0; k < 61; k++){output=coef[k]*x[k] + output;}
   // Serial.println(output);       
    analogWrite(DAC0,output);
    output=0;
     
    

    //digitalWrite(13,LOW);
 vTaskDelayUntil(&xLastWakeTime,(1/(portTICK_RATE_MS)));
   
   
    }
    
  }
  
void loop() {}


